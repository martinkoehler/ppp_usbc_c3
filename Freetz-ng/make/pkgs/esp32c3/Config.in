## Freetz-ng/make/pkgs/esp32c3/Config.in
```kconfig
config FREETZ_PACKAGE_ESP32C3
	bool "esp32c3 USB PPP and MQTT integration"
	default n
	depends on (FREETZ_REPLACE_MODULE_AVAILABLE && !FREETZ_KERNEL_VERSION_2_6_28) || FREETZ_REPLACE_KERNEL
	select FREETZ_PACKAGE_PPP
	select FREETZ_PACKAGE_PPPD
	select FREETZ_PACKAGE_MQTT2SQLITE
	help
	  Connect an ESP32-C3 over USB CDC ACM and PPP, route its Wi-Fi
	  subnet, and collect its messages from the FRITZ!Box MQTT broker
	  in SQLite.

if FREETZ_PACKAGE_ESP32C3

config FREETZ_PACKAGE_ESP32C3_WITH_GRAFANA
	bool "Include mqtt-grafana JSON endpoint"
	default y
	select FREETZ_PACKAGE_MQTT_GRAFANA
	help
	  Include the read-only CGI endpoint for querying the collector database.

comment "PPP connection"

config FREETZ_PACKAGE_ESP32C3_SERIAL_DEVICE
	string "USB serial device"
	default "/dev/ttyACM0"

config FREETZ_PACKAGE_ESP32C3_SERIAL_BAUD
	int "Serial baud rate"
	range 1200 4000000
	default 115200

config FREETZ_PACKAGE_ESP32C3_PPP_LOCAL_IP
	string "FRITZ!Box PPP address"
	default "192.168.83.1"

config FREETZ_PACKAGE_ESP32C3_PPP_REMOTE_IP
	string "ESP32-C3 PPP address"
	default "192.168.83.2"

config FREETZ_PACKAGE_ESP32C3_PPP_DNS
	string "DNS address offered over PPP"
	default "192.168.178.1"

config FREETZ_PACKAGE_ESP32C3_ROUTE_NET
	string "ESP32-C3 routed Wi-Fi subnet"
	default "192.168.4.0/24"

comment "MQTT to SQLite collector"

config FREETZ_PACKAGE_ESP32C3_MQTT_BROKER
	string "MQTT broker address"
	default "127.0.0.1"
	help
	  The broker runs on the FRITZ!Box. 127.0.0.1 lets the collector
	  work independently of whether OpenBeken reaches the box through
	  the ESP32 access point or the FRITZ!Box WLAN.

config FREETZ_PACKAGE_ESP32C3_MQTT_PORT
	int "MQTT broker port"
	range 1 65535
	default 1883

config FREETZ_PACKAGE_ESP32C3_MQTT_TOPICS
	string "MQTT topics (comma- or space-separated)"
	default "+/power/get,+/energycounter/get"

config FREETZ_PACKAGE_ESP32C3_MQTT_DB_PATH
	string "SQLite database path"
	default "/var/media/ftp/FLASH/mqtt_messages.db"
	help
	  Use an absolute path on persistent storage. For paths below
	  /var/media/ftp/<volume>/, the service waits until that volume is
	  mounted before starting mqtt_to_sqlite. mqtt-grafana uses this same
	  value when it is selected through the esp32c3 package.

config FREETZ_PACKAGE_ESP32C3_MQTT_CLIENT_ID
	string "MQTT client ID"
	default "fritzbox-mqtt2sqlite"

config FREETZ_PACKAGE_ESP32C3_NETWORK_FIX_SCRIPT
	string "Network repair command"
	default "/bin/true"
	help
	  Command run after a broker connection error. /bin/true disables
	  active repair while retaining the collector's reconnect loop.

config FREETZ_PACKAGE_ESP32C3_RECONNECT_MIN_S
	int "Minimum reconnect delay (seconds)"
	range 0 86400
	default 2

config FREETZ_PACKAGE_ESP32C3_RECONNECT_MAX_S
	int "Maximum reconnect delay (seconds)"
	range 0 86400
	default 60

config FREETZ_PACKAGE_ESP32C3_RETRY_SLEEP_AFTER_SCRIPT_S
	int "Delay after network repair command (seconds)"
	range 0 86400
	default 5

config FREETZ_PACKAGE_ESP32C3_MQTT_LOG_INSERTS
	bool "Log every SQLite insert"
	default n

if FREETZ_PACKAGE_ESP32C3_WITH_GRAFANA

comment "mqtt-grafana"

config FREETZ_PACKAGE_ESP32C3_GRAFANA_TOPIC
	string "Dashboard power topic"
	default "OBK-681/power/get"
	help
	  Exact MQTT topic displayed by the power dashboard. Unlike the
	  collector subscriptions, this must not contain MQTT wildcards.

config FREETZ_PACKAGE_ESP32C3_GRAFANA_MAX_ROWS
	int "Maximum rows per request"
	range 1 100000
	default 20000

config FREETZ_PACKAGE_ESP32C3_GRAFANA_ALLOWED_IP
	string "Allowed client IP (empty permits all authenticated clients)"
	default ""

endif

endif
```

## Freetz-ng/make/pkgs/mqtt-grafana/Config.in
```kconfig
config FREETZ_PACKAGE_MQTT_GRAFANA
	bool "mqtt-grafana (SQLite JSON endpoint)"
	default n
	select FREETZ_LIB_libsqlite3
	help
	  Read-only CGI endpoint for Grafana. It exposes MQTT messages stored
	  by mqtt2sqlite as JSON through the Freetz web server on port 81.

if FREETZ_PACKAGE_MQTT_GRAFANA

config FREETZ_PACKAGE_MQTT_GRAFANA_TOPIC
	string "Dashboard power topic" if !FREETZ_PACKAGE_ESP32C3
	default FREETZ_PACKAGE_ESP32C3_GRAFANA_TOPIC if FREETZ_PACKAGE_ESP32C3
	default "OBK-681/power/get"
	help
	  Exact MQTT topic displayed by the power dashboard.

config FREETZ_PACKAGE_MQTT_GRAFANA_DB_PATH
	string "SQLite database path" if !FREETZ_PACKAGE_ESP32C3
	default FREETZ_PACKAGE_ESP32C3_MQTT_DB_PATH if FREETZ_PACKAGE_ESP32C3
	default "/var/media/ftp/FLASH-1/mqtt_messages.db"
	help
	  Absolute path to the SQLite database created by mqtt_to_sqlite.

config FREETZ_PACKAGE_MQTT_GRAFANA_MAX_ROWS
	int "Maximum rows per request" if !FREETZ_PACKAGE_ESP32C3
	range 1 100000
	default FREETZ_PACKAGE_ESP32C3_GRAFANA_MAX_ROWS if FREETZ_PACKAGE_ESP32C3
	default 20000
	help
	  Hard upper bound for rows returned by one HTTP request.

config FREETZ_PACKAGE_MQTT_GRAFANA_ALLOWED_IP
	string "Allowed client IP (empty permits all authenticated clients)" if !FREETZ_PACKAGE_ESP32C3
	default FREETZ_PACKAGE_ESP32C3_GRAFANA_ALLOWED_IP if FREETZ_PACKAGE_ESP32C3
	default ""
	help
	  Exact REMOTE_ADDR allowed to use the endpoint, normally the Grafana
	  host IPv4 or IPv6 address. Leave empty to rely on port-81 authentication.

endif
```

## Freetz-ng/make/pkgs/mqtt2sqlite/Config.in
```kconfig
config FREETZ_PACKAGE_MQTT2SQLITE
	bool "mqtt2sqlite (MQTT -> SQLite collector)"
	default n
	select FREETZ_PACKAGE_MOSQUITTO
	select FREETZ_LIB_libsqlite3
	help
	  A robust MQTT collector that subscribes to MQTT topics and stores
	  messages into a local SQLite DB.

	  Binary: /usr/bin/mqtt_to_sqlite
```

## sdkconfig.defaults
```kconfig
# This is for a esp32-C3
CONFIG_IDF_TARGET="esp32c3"
CONFIG_ESPTOOLPY_FLASHSIZE_4MB=y

# Use USB Serial/JTAG for flashing, but NOT for console output
CONFIG_ESP_CONSOLE_UART_DEFAULT=y
CONFIG_ESP_CONSOLE_SECONDARY_NONE=y

# Reduce log noise
CONFIG_LOG_DEFAULT_LEVEL_INFO=y

# PPP/LwIP
CONFIG_LWIP_PPP_SUPPORT=y
CONFIG_LWIP_PPP_PAP_SUPPORT=y
CONFIG_LWIP_PPP_CHAP_SUPPORT=y
CONFIG_LWIP_PPP_MSCHAP_SUPPORT=y
CONFIG_LWIP_PPP_NOTIFY_PHASE_SUPPORT=y
CONFIG_LWIP_TCPIP_TASK_STACK_SIZE=5120
CONFIG_LWIP_IP_FORWARD=y
CONFIG_LWIP_MAX_SOCKETS=16

# Partition table
CONFIG_PARTITION_TABLE_CUSTOM=y
CONFIG_PARTITION_TABLE_CUSTOM_FILENAME="partitions.csv"
CONFIG_PARTITION_TABLE_FILENAME="partitions.csv"
CONFIG_PARTITION_TABLE_OFFSET=0x8000
CONFIG_PARTITION_TABLE_MD5=y
CONFIG_MQTT_PROTOCOL_5=y
```
